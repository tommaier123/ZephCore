## zephcore/west.yml
```yaml
manifest:
  remotes:
    - name: zephyrproject-rtos
      url-base: https://github.com/zephyrproject-rtos

  projects:
    - name: zephyr
      remote: zephyrproject-rtos
      revision: 2da21149607c5783ec8c36d957b2bf684af9a1d4
      import: true

  self:
    path: zephcore
```
